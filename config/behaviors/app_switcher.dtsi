/ {
    macros {
        app_switcher: app_switcher {
            compatible = "zmk,behavior-macro-two-param";
            #binding-cells = <2>;
            bindings
                = <&macro_param_1to1>
                , <&macro_tap &to MACRO_PLACEHOLDER>
                , <&macro_param_2to1>
                , <&macro_tap MACRO_PLACEHOLDER>
                ;
        };
    };
};